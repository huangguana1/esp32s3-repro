## main/Kconfig.projbuild
```kconfig
menu "Reproduction configuration (Path B rogue-AP)"

config REPRO_RUN_DEMO
    bool "Non-interactive demo mode"
    default n
    help
        If enabled, use the SSID configured below instead of asking on the
        serial console. Only use with an AP you own.

config REPRO_TARGET_SSID
    string "Target SSID for demo mode (YOUR OWN router)"
    default ""
    help
        Exact SSID of an access point you own or are authorised to test.

config REPRO_DEMO_SECONDS
    int "Seconds to run the clone AP"
    default 30
    range 5 300

endmenu
```

## sdkconfig.defaults
```kconfig
CONFIG_IDF_TARGET_ESP32S3=y
CONFIG_ESP32S3_FLASH_SIZE_4MB=y
CONFIG_ESPTOOLPY_FLASHSIZE_4MB=y
CONFIG_ESPTOOLPY_FLASHMODE_DIO=y
CONFIG_ESPTOOLPY_FLASHFREQ_80M=y
CONFIG_COMPILER_OPTIMIZATION_DEFAULT=y
CONFIG_LOG_DEFAULT_LEVEL_INFO=y
CONFIG_ESP32S3_DATA_CACHE_64KB=y
CONFIG_FREERTOS_HZ=100
```
